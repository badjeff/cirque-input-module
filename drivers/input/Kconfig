## drivers/input/Kconfig
```kconfig
# Copyright (c) 2022 The ZMK Contributors
# SPDX-License-Identifier: MIT

menuconfig INPUT_PINNACLE
    bool "Cirque Pinnacle trackpads"
    default y
    depends on GPIO
    depends on SPI || I2C
    depends on INPUT
    depends on DT_HAS_CIRQUE_PINNACLE_ENABLED
    help
      Enable driver for Cirque Pinnacle trackpads

config INPUT_PINNACLE_REPORT_INTERVAL_MIN
    int "Cirque Pinnacl's minimum report rate"
    default 0
    help
      Default minimum report interval in milliseconds.
      Slow down input reporting for hid queue over the air.
```
